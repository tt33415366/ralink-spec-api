## Config.in
```kconfig
menu "Ralink HW NAT API"
	depends on PACKAGE_kmod-ralink-spec-api
	
config RA_HW_NAT_API
	bool "Ralink Hardware NAT API"
	default y
	
config RA_HW_NAT_WIFI_NEW_ARCH_API
	bool "Ralink HW NAT for new arch WIFI"
	default n
	
endmenu

config RA_MTD_RW_BY_NUM_API
	depends on PACKAGE_kmod-ralink-spec-api
	bool "Ralink Read/Write MTD by MTD number API"
	default y
```
